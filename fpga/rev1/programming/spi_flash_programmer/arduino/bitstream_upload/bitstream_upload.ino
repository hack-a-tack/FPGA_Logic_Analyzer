/*
-- MODULE: bitstream_upload.ino
-- FUNCTION: upload bitstream (together with python script) to SPI flash
-- AUTHOR: Jakob Kieszek Ottesen
-- CREATED: 2026-05-11 (YYYY-MM-DD)
-- MODIFIED: 2026-05-14

Arduino: Pro Micro

CIRCUIT:
  CS#: pin 10    DEFAULT
  MOSI: pin 16   DEFAULT
  MISO: pin 14   DEFAULT
  SCK: pin 15    DEFAULT
  GND: important with common ground between arduino, voltage dividers and FPGA PCB

  Voltage divider used for lines: CS#, MOSI, and SCK (signals generated by Arduino)
  
  Arduino output -- 220 ohm -- 220 ohm -- + -- FPGA/flash input
                                          |
                                        330 ohm
                                          |
                                        330 ohm
                                          |
                                         GND
  
  This gives ~3V instead of 5V output from the Arduino, preventing backpowering of the PCB
    5V * 660 / (440 + 660) = 3.0V
  
  Downside: low-value divider which burns more current. Specifically ~4.5mA (5V / 1100ohms ~= 4.5mA)

SPI FLASH: Winbond W25Q40CL
  Density: 4 Mbit = 512 KiB = 524,288 bytes
  Page size: 256 bytes
  Number of pages: 2048
  Sector size: 4kB
  Number of sectors: 128
  Number of pages per sector: 16

  bitmap file size: 104,157 bytes --> / 4096 (sector size) --> 26 x (4k) sectors
  104,157 bytes / 256 bytes per page = 407 pages (only 221/256 bytes on last page)
  Numbers to keep in mind: 26 (4k) sectors. 16 (256 byte) pages per sector. 256 bytes per page.

  So sector 0 contains page start addresses:
  0x000000
  0x000100
  0x000200
  ...
  0x000F00
  
  Sector 1 contains:
  0x001000
  0x001100
  ...
  0x001F00

NOTE that the FPGA must be held in reset (CRESET_B pulled low using DIP switch) during programming.
*/

#include <SPI.h>  // arduino and flash communicate via SPI, so include the library:

const int PIN_MOSI = 16;  // use PIN_ prefix to avoid conflict with Arduino core definitions
const int PIN_SCK = 15;
const int PIN_MISO = 14;
const int chipSelectPin = 10;

const int SPI_SPEED = 100000;  // 100kHz
SPISettings flashSPI(SPI_SPEED, MSBFIRST, SPI_MODE0);

uint8_t pageBuf[256];     // stores incoming page data from Python
uint8_t verifyBuf[256];   // stores flash readback data for comparison


void readJEDEC(uint8_t *id) {
  // Reads flash JEDEC ID. Expecting 239 (0xEF), 64 (0x40), 19 (0x13)
  SPI.beginTransaction(flashSPI);
  digitalWrite(chipSelectPin, LOW);
  SPI.transfer(0x9F);  // JEDEC ID request
  id[0] = SPI.transfer(0x00);
  id[1] = SPI.transfer(0x00);
  id[2] = SPI.transfer(0x00);
  digitalWrite(chipSelectPin, HIGH);
  // delayMicroseconds(1);
  SPI.endTransaction();
}

uint8_t readStatus1() {
  // Read status register 1
  SPI.beginTransaction(flashSPI);
  digitalWrite(chipSelectPin, LOW);
  SPI.transfer(0x05);
  uint8_t status = SPI.transfer(0x00);
  digitalWrite(chipSelectPin, HIGH);
  delayMicroseconds(1);
  SPI.endTransaction();
  return status;
}

void writeEnable() {
  // Required for every page program, sector erase, block erase, chip erase, write status register and erase/program security registers instruction
  // WEL (write enable latch) is automatically reset after power-up and upon compltion of the write status registe, erase/program security registers, ...
  // ... page program, sector erase, block erase and chip erase instructions
  SPI.beginTransaction(flashSPI);
  digitalWrite(chipSelectPin, LOW);
  SPI.transfer(0x06);
  digitalWrite(chipSelectPin, HIGH);
  delayMicroseconds(1);
  SPI.endTransaction();
}

void releasePowerDownAB() {
  // Release SPI flash from power down
  SPI.beginTransaction(flashSPI);
  digitalWrite(chipSelectPin, LOW);
  SPI.transfer(0xAB);  // release power down
  digitalWrite(chipSelectPin, HIGH);
  delayMicroseconds(1);
  SPI.endTransaction();
  delayMicroseconds(5);
}

uint8_t readDeviceIdAB() {
  // Release SPI flash from power down and wait for 4th byte (unique flash ID)
  SPI.beginTransaction(flashSPI);
  digitalWrite(chipSelectPin, LOW);
  SPI.transfer(0xAB);
  SPI.transfer(0x00);
  SPI.transfer(0x00);
  SPI.transfer(0x00);
  uint8_t id = SPI.transfer(0x00);
  digitalWrite(chipSelectPin, HIGH);
  delayMicroseconds(1);
  SPI.endTransaction();
  return id;
}

void printHexByte(uint8_t value) {
  // Formats value to hex value and prints to serial interface
  Serial.print("0x");
  if (value < 0x10) Serial.print("0");
  Serial.print(value, HEX);
}

void printHexByteln(uint8_t value) {
  // Formats value to hex value and prints to serial interface
  // Adds newline to the end
  Serial.print("0x");
  if (value < 0x10) Serial.print("0");
  Serial.println(value, HEX);
}

void waitBusyClear() {
  // Waits until status bit 0 (BUSY bit) goes low (high during sector erase cycle / page program cycle; low when the cycle is finished)
  while (readStatus1() & 0x01) {
    delay(1);
  }
}

void sendAddress(uint32_t addr) {
  // Uses uint32_t because no uint24_t available. Address is 24 bits long
  SPI.transfer((addr >> 16) & 0xFF);
  SPI.transfer((addr >> 8) & 0xFF);
  SPI.transfer(addr & 0xFF);
}

void sectorErase4k(uint32_t addr) {
  // Erase 4kB sector containing byte address addr
  writeEnable();

  SPI.beginTransaction(flashSPI);
  digitalWrite(chipSelectPin, LOW);
  SPI.transfer(0x20);
  sendAddress(addr);
  digitalWrite(chipSelectPin, HIGH);
  delayMicroseconds(1);
  SPI.endTransaction();

  waitBusyClear();
}

void pageProgram(uint32_t addr, const uint8_t *data, uint16_t len) {
  // You can program one page at a time. 16 pages per sector.
  // addr = exact flash byte address where data[0] should be written
  /*
    Examples
      pageProgram(0x000000, data, 256);  // writes bytes 0x000000–0x0000FF
      pageProgram(0x000100, data, 256);  // writes bytes 0x000100–0x0001FF
      pageProgram(0x000200, data, 256);  // writes bytes 0x000200–0x0002FF
  */
  // len must be <= 256 and must not cross a 256-byte page boundary
  writeEnable();

  SPI.beginTransaction(flashSPI);
  digitalWrite(chipSelectPin, LOW);
  SPI.transfer(0x02);
  sendAddress(addr);  // byte address of first byte to program

  for (uint16_t i = 0; i < len; i++) {
    SPI.transfer(data[i]);
  }

  digitalWrite(chipSelectPin, HIGH);
  delayMicroseconds(1);
  SPI.endTransaction();

  waitBusyClear();
}

void readData(uint32_t addr, uint8_t *buf, uint16_t len) {
  // Read len bytes starting from flash byte address addr into buf
  SPI.beginTransaction(flashSPI);
  digitalWrite(chipSelectPin, LOW);
  SPI.transfer(0x03);
  sendAddress(addr);  // address of sector from which you want to read data

  for (uint16_t i = 0; i < len; i++) {
    buf[i] = SPI.transfer(0x00);
  }

  digitalWrite(chipSelectPin, HIGH);
  delayMicroseconds(1);
  SPI.endTransaction();
}

void confirmFlashCommunication() {
  // -------------------------------------------------------------------------
  // DIAGNOSTICS / confirm flash resopnse ------------------------------------
  // -------------------------------------------------------------------------

  uint8_t JEDEC_buf[3] = {0};
  readJEDEC(JEDEC_buf);
  Serial.println("JEDEC ID request command (0x9F) written to to SPI flash");
  Serial.print("Received (expecting 0xEF, 0x40, 0x13): ");
  printHexByte(JEDEC_buf[0]);
  Serial.print(" ");
  printHexByte(JEDEC_buf[1]);
  Serial.print(" ");
  printHexByteln(JEDEC_buf[2]);

  releasePowerDownAB();
  Serial.println("Release power down command (0xAB) written to SPI flash");

  Serial.print("AB Device ID (expecting 0x12): ");
  printHexByteln(readDeviceIdAB());

  Serial.print("Status before WREN (expecting 0x00): ");
  uint8_t before_status = readStatus1();
  printHexByteln(before_status);

  writeEnable();
  Serial.println("Write enable command (0x06) written to SPI flash");

  Serial.print("Status after WREN (expecting 0x02): ");
  uint8_t after_status = readStatus1();
  printHexByteln(after_status);
}

void testEraseReadProgramRead() {
  // -------------------------------------------------------------------------
  // Micro-test: erase + read; program + read --------------------------------
  // -------------------------------------------------------------------------
  uint8_t buffer[16] = {0};

  uint8_t testPattern[16] = {
    0x00, 0x11, 0x22, 0x33,
    0x44, 0x55, 0x66, 0x77,
    0x88, 0x99, 0xAA, 0xBB,
    0xCC, 0xDD, 0xEE, 0xFF
  };

  Serial.println("Erasing sector 0...");
  sectorErase4k(0x000000);

  Serial.println("Reading after erase...");
  readData(0x000000, buffer, 16);

  Serial.print("Erase readback: ");
  for (int i = 0; i < 16; i++) {
    if (buffer[i] < 0x10) Serial.print("0");
    Serial.print(buffer[i], HEX);
    Serial.print(" ");
  }
  Serial.println();

  Serial.println("Programming test pattern...");
  pageProgram(0x000000, testPattern, 16);

  Serial.println("Reading after program...");
  readData(0x000000, buffer, 16);

  Serial.print("Program readback: ");
  for (int i = 0; i < 16; i++) {
    if (buffer[i] < 0x10) Serial.print("0");
    Serial.print(buffer[i], HEX);
    Serial.print(" ");
  }
  Serial.println();

  bool pass = true;
  for (int i = 0; i < 16; i++) {
    if (buffer[i] != testPattern[i]) {
      pass = false;
    }
  }

  if (pass) {
    Serial.println("PASS: readback matches test pattern");
  } else {
    Serial.println("FAIL: readback mismatch");
  }
}



// -----------------------------------------------------------------------------------------------------
// Functions used for communicating with python script over serial line --------------------------------
// -----------------------------------------------------------------------------------------------------
bool readExact(uint8_t *buf, uint16_t len) {
  // Reads exactly len bytes from USB serial into buf
  uint16_t got = 0;
  unsigned long start = millis();

  while (got < len) {
    if (Serial.available()) {
      buf[got++] = (uint8_t)Serial.read();
      start = millis();
    }

    if (millis() - start > 2000) {
      return false;
    }
  }

  return true;
}

bool readU32BE(uint32_t *out) {
  // Reads 4 bytes from serial and converts to a 32-bit address (python sends big-endian)
  uint8_t b[4];
  if (!readExact(b, 4)) return false;

  *out = ((uint32_t)b[0] << 24) |
         ((uint32_t)b[1] << 16) |
         ((uint32_t)b[2] << 8)  |
         ((uint32_t)b[3]);
  
  return true;
}

bool readU16BE(uint16_t *out) {
  // Reads 2 bytes from serial and converts to a 16-bit address (python sends big-endian)
  // Used for page length, checksum, data length
  uint8_t b[2];
  if (!readExact(b, 2)) return false;

  *out = ((uint16_t)b[0] << 8) | b[1];

  return true;
}

uint16_t checksum16(const uint8_t *buf, uint16_t len) {
  // Computes simple 16-bit sum of data bytes
  // Used to detect corrupted serial packets before programming flash
  uint16_t s = 0;
  for (uint16_t i = 0; i < len; i++) {
    s += buf[i];
  }
  return s;
}

void sendOK() {
  Serial.write('K');
}

void sendFail(uint8_t code) {
  Serial.write('F');
  Serial.write(code);
}

void tristatePins() {
  // Disables SPI and makes pins high impedance.
  // Purpose: Arduino stops driving the SPI bus before FPGA tries to boot.
  // Reality check: for maximum certainty, physically disconnect Arduino after programming. But this function helps.
  SPI.end();

  pinMode(chipSelectPin, INPUT);
  pinMode(PIN_MOSI, INPUT);
  pinMode(PIN_SCK, INPUT);
  pinMode(PIN_MISO, INPUT);
}



// -------------------------------------------------------
// Arduino setup and loop --------------------------------
// -------------------------------------------------------
void setup() {
  Serial.begin(115200);  

  // Explicitly set inputs/outputs
  pinMode(PIN_MOSI, OUTPUT);          // 16
  pinMode(PIN_SCK, OUTPUT);           // 15
  pinMode(PIN_MISO, INPUT);           // 14
  pinMode(chipSelectPin, OUTPUT);     // 10
  digitalWrite(chipSelectPin, HIGH);  // default high

  SPI.begin();  // start the SPI library
  delay(1000);  // give the SPI flash time to set up

  //confirmFlashCommunication();  // MUST BE COMMENTED OUT DURING PROPER FLASH PROGRAMMING! (because they contain serial prints)
  //testEraseReadProgramRead();   // MUST BE COMMENTED OUT DURING PROPER FLASH PROGRAMMING! (because they contain serial prints)
}

void loop() {
  if (!Serial.available()) return;

  uint8_t cmd = Serial.read();

  if (cmd == 'J') {
    uint8_t id[3];
    readJEDEC(id);

    sendOK();
    Serial.write(id, 3);
  }

  else if (cmd == 'E') {  // ERASE
    uint32_t addr;

    if (!readU32BE(&addr)) {
      sendFail(10);
      return;
    }

    sectorErase4k(addr);

    sendOK();
  }

  else if (cmd == 'P') {  // PROGRAM   
    uint32_t addr;
    uint16_t len;

    if (!readU32BE(&addr)) {
      sendFail(11);
      return;
    }

    if (!readU16BE(&len)) {
      sendFail(12);
      return;
    }

    if (len == 0 || len > 256) {  // Reject: if no data or too any data bytes for one page
      sendFail(1);
      return;
    }

    if (((addr & 0xFF) + len) > 256) {  // Reject: if data would cross page boundary
      sendFail(2);
      return;
    }

    // Store data from python in pageBuf
    if (!readExact(pageBuf, len)) {  // Reject: if timeout (2 seconds without progress) or length not as expected
      sendFail(3);
      return;
    }

    // Read checksum from Python and compute local checksum
    uint16_t expectedChecksum;

    if (!readU16BE(&expectedChecksum)) {
      sendFail(13);
      return;
    }

    uint16_t actualChecksum = checksum16(pageBuf, len);

    if (expectedChecksum != actualChecksum) {  // Reject: if corrupted serial packet
      sendFail(4);
      return;
    }

    pageProgram(addr, pageBuf, len);

    readData(addr, verifyBuf, len);

    for (uint16_t i = 0; i < len; i++) {
      if (verifyBuf[i] != pageBuf[i]) {
        sendFail(5);
        return;
      }
    }

    sendOK();
  }

  else if (cmd == 'R') {  // VERIFY
    uint32_t addr;
    uint16_t len;

    if (!readU32BE(&addr)) {
      sendFail(14);
      return;
    }

    if (!readU16BE(&len)) {
      sendFail(15);
      return;
    }

    if (len == 0 || len > 256) {  // Limit reads to 256 bytes
      sendFail(6);
      return;
    }

    readData(addr, pageBuf, len);

    sendOK();
    Serial.write(pageBuf, len);
  }

  else if (cmd == 'Z') {
    tristatePins();
    sendOK();
  }

  else {
    sendFail(99);
  }
}


